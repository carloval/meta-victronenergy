## meta-bsp/conf/machine/include/rpi-base.inc
```bitbake
SOC_FAMILY = "rpi"
include conf/machine/include/soc-family.inc

WKS_FILE ?= "sdimage-raspberrypi.wks"

RPI_KERNEL_DEVICETREE_OVERLAYS ?= ""
RPI_KERNEL_DEVICETREE ?= ""

KERNEL_DEVICETREE ?= " \
    ${RPI_KERNEL_DEVICETREE} \
    ${RPI_KERNEL_DEVICETREE_OVERLAYS} \
"

KERNEL_PACKAGES ?= "kernel-image kernel-modules"
KERNEL_IMAGETYPE ?= "zImage"
UBOOT_BINARY ?= "u-boot.bin"

MACHINE_FEATURES += "apm usbhost keyboard vfat ext2 screen touchscreen alsa bluetooth wifi sdio ${@bb.utils.contains('DISABLE_VC4GRAPHICS', '1', '', 'vc4graphics', d)}"

# Raspberry Pi has no hardware clock
MACHINE_FEATURES_BACKFILL_CONSIDERED = "rtc"

IMAGE_BOOT_FILES ?= " \
    bcm2835-bootfiles/* \
    config.txt \
    ${KERNEL_DEVICETREE} \
    ${UBOOT_BINARY} \
"

do_image_wic[depends] += " \
    bcm2835-bootfiles:do_deploy \
    virtual/bootloader:do_deploy \
"

do_image_wic[recrdeps] = "do_deploy"
```

## meta-bsp/conf/machine/raspberrypi4.conf
```bitbake
#@TYPE: Machine
#@NAME: RaspberryPi 4 Development Board (32bit)
#@DESCRIPTION: Machine configuration for the RaspberryPi 4 in 32 bit mode

DEFAULTTUNE ?= "cortexa7hf-neon-vfpv4"
require conf/machine/include/tune-cortexa7.inc
require conf/machine/include/rpi-base.inc

PREFERRED_PROVIDER_virtual/kernel ?= "linux-raspberrypi"
PREFERRED_VERSION_linux-raspberrypi = "4.19.%"
RPI_KERNEL_DEVICETREE = "bcm2711-rpi-4-b.dtb"

PREFERRED_PROVIDER_virtual/bootloader = "u-boot-venus"
PREFERRED_VERSION_u-boot-fw-utils = "venus"

ENABLE_UART = "1"

UBOOT_SRC_URI = "git://github.com/victronenergy/u-boot.git;branch=rpi;tag=b6ccae323a7220c779b26f671b4fec5a061fa31b"
UBOOT_MACHINE = "rpi_4_32b_config"
SERIAL_CONSOLES ?= "-l;/sbin/autologin;-n;115200;ttyS0"

KERNEL_PACKAGES = "kernel-modules kernel-image"
KERNEL_IMAGETYPE = "zImage"
IMAGE_BOOT_FILES ?= "boot/*"
UBOOT_SUFFIX = "bin"

VC4DTBO ?= "vc4-fkms-v3d"
ARMSTUB ?= "armstub7.bin"

IMAGE_FSTYPES ?= "wic ext4.gz"
WKS_FILE ?= "sdimage-raspberrypi.wks"

# can be removed on zorro
PREFERRED_VERSION_wireless-regdb = "2019.06.03"
```
